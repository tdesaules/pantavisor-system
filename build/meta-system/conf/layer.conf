## build/meta-system/conf/layer.conf
```bitbake
BBPATH .= ":${LAYERDIR}"
BBFILES += "${LAYERDIR}/recipes-*/*/*.bb ${LAYERDIR}/recipes-*/*/*.bbappend"
BBFILE_COLLECTIONS += "platformsystem"
BBFILE_PATTERN_platformsystem = "^${LAYERDIR}/"
BBFILE_PRIORITY_platformsystem = "10"
LAYERSERIES_COMPAT_platformsystem = "scarthgap"
LAYERDEPENDS_platformsystem = "core"
SYSTEM_REPO_ROOT := "${LAYERDIR}/../.."
```
